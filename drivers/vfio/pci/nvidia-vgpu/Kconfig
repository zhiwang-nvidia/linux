## drivers/vfio/pci/nvidia-vgpu/Kconfig
```kconfig
# SPDX-License-Identifier: GPL-2.0-only
config NVIDIA_VGPU_VFIO_PCI
	tristate "VFIO support for the NVIDIA vGPU"
	select VFIO_PCI_CORE
	help
	  This option enables VFIO (Virtual Function I/O) support for
	  NVIDIA virtual GPUs (vGPU). It allows the assignment of a virtual
	  GPU instance to userspace applications via VFIO, typically used
	  with hypervisors such as KVM and device emulators like QEMU.

          The NVIDIA vGPU allows a physical GPU to be partitioned into
	  multiple virtual GPUs, each of which can be passed to a virtual
	  machine as a PCI device using the standard VFIO infrastructure.

	  If you don't know what to do here, say N.
```
